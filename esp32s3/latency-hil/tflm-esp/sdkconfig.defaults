## esp32s3/latency-hil/tflm-esp/sdkconfig.defaults
```kconfig
# Common defaults: custom partition table (15MB app for large models)
CONFIG_PARTITION_TABLE_CUSTOM=y
CONFIG_PARTITION_TABLE_CUSTOM_FILENAME="partitions.csv"
CONFIG_ESP_MAIN_TASK_STACK_SIZE=32768
# Disable watchdogs for long-running inference
CONFIG_ESP_TASK_WDT_EN=n
CONFIG_ESP_INT_WDT=n
CONFIG_BOOTLOADER_WDT_ENABLE=n
# C++ exceptions required by TFLM
CONFIG_COMPILER_CXX_EXCEPTIONS=y
```

## esp32s3/latency-hil/tigris-esp/sdkconfig.defaults
```kconfig
# Common defaults: applies to all targets
CONFIG_PARTITION_TABLE_CUSTOM=y
CONFIG_ESP_MAIN_TASK_STACK_SIZE=65536
# Disable all watchdogs for long-running inference
CONFIG_ESP_TASK_WDT_EN=n
CONFIG_ESP_INT_WDT=n
CONFIG_BOOTLOADER_WDT_ENABLE=n
```

## tflm-esp32s3/tflm-esp/sdkconfig.defaults.esp32s3
```kconfig
# ESP32-S3-DevKitC-1 N16R8
CONFIG_SPIRAM=y
CONFIG_SPIRAM_MODE_OCT=y
CONFIG_SPIRAM_SPEED_80M=y
CONFIG_ESP_DEFAULT_CPU_FREQ_MHZ_240=y
CONFIG_SPIRAM_USE_CAPS_ALLOC=y
CONFIG_ESPTOOLPY_FLASHSIZE_16MB=y
CONFIG_ESP_TASK_WDT_TIMEOUT_S=300
```

## tflm-esp32s3/tigris-esp/sdkconfig.defaults.esp32s3
```kconfig
# ESP32-S3-DevKitC-1 N16R8 (16 MB flash, 8 MB octal PSRAM)
CONFIG_SPIRAM=y
CONFIG_SPIRAM_MODE_OCT=y
CONFIG_SPIRAM_SPEED_80M=y
CONFIG_ESP_DEFAULT_CPU_FREQ_MHZ_240=y
CONFIG_SPIRAM_USE_CAPS_ALLOC=y
CONFIG_ESPTOOLPY_FLASHSIZE_16MB=y
CONFIG_PARTITION_TABLE_CUSTOM_FILENAME="partitions.csv"
CONFIG_ESP_TASK_WDT_TIMEOUT_S=300
```
