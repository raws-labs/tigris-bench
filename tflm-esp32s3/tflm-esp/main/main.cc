/*
 * TFLite Micro ESP32-S3 Benchmark Harness
 *
 * Runs DS-CNN keyword spotting model with warmup + N timed inference runs.
 * Reports min/max/mean/stdev latency in machine-parseable format.
 *
 * Model selection via build define:
 *   -DBENCH_INT8=1   int8 quantized model
 *   default          f32 model
 *
 * Machine-parseable output:
 *   BENCH_RESULT:latency_mean_ms=X,latency_min_ms=X,...
 *   BENCH_DONE
 */

#include <cstdio>
#include <cstring>
#include <cmath>
#include <cinttypes>

#include "esp_heap_caps.h"
#include "esp_timer.h"
#include "esp_log.h"
#include "hal/wdt_hal.h"

#include "tensorflow/lite/micro/micro_mutable_op_resolver.h"
#include "tensorflow/lite/micro/micro_interpreter.h"
#include "tensorflow/lite/schema/schema_generated.h"

/* Model data, generated by models/prepare.py */
#if defined(BENCH_WIDE)
#include "mobilenet_v1_tflite_i8.h"
static const unsigned char *model_data = mobilenet_v1_tflite_i8;
static const unsigned int model_data_len = mobilenet_v1_tflite_i8_len;
static const char *dtype_name = "int8";
static const char *model_name = "mobilenet_v1";
#elif defined(BENCH_INT8)
#include "ds_cnn_tflite_i8.h"
static const unsigned char *model_data = ds_cnn_tflite_i8;
static const unsigned int model_data_len = ds_cnn_tflite_i8_len;
static const char *dtype_name = "int8";
static const char *model_name = "ds_cnn";
#else
#include "ds_cnn_tflite.h"
static const unsigned char *model_data = ds_cnn_tflite;
static const unsigned int model_data_len = ds_cnn_tflite_len;
static const char *dtype_name = "f32";
static const char *model_name = "ds_cnn";
#endif

static const char *TAG = "bench";

#define WARMUP_RUNS 3
#define BENCH_RUNS  10

/* Tensor arena: match TiGrIS 256 KB budget */
constexpr int kTensorArenaSize = 256 * 1024;
static uint8_t tensor_arena[kTensorArenaSize] __attribute__((aligned(16)));

extern "C" {

static void disable_all_wdts(void) {
    wdt_hal_context_t ctx;

    wdt_hal_init(&ctx, WDT_MWDT0, 0, false);
    wdt_hal_write_protect_disable(&ctx);
    wdt_hal_set_flashboot_en(&ctx, false);
    wdt_hal_disable(&ctx);
    wdt_hal_write_protect_enable(&ctx);

    wdt_hal_init(&ctx, WDT_MWDT1, 0, false);
    wdt_hal_write_protect_disable(&ctx);
    wdt_hal_set_flashboot_en(&ctx, false);
    wdt_hal_disable(&ctx);
    wdt_hal_write_protect_enable(&ctx);

    wdt_hal_init(&ctx, WDT_RWDT, 0, false);
    wdt_hal_write_protect_disable(&ctx);
    wdt_hal_set_flashboot_en(&ctx, false);
    wdt_hal_disable(&ctx);
    wdt_hal_write_protect_enable(&ctx);
}

void app_main(void) {
    disable_all_wdts();

    printf("\nTFLite Micro Benchmark (dtype=%s)\n\n", dtype_name);

    /* 1. Load model */
    const tflite::Model *model = tflite::GetModel(model_data);
    if (model->version() != TFLITE_SCHEMA_VERSION) {
        ESP_LOGE(TAG, "schema version mismatch: got %lu, expected %d",
                 (unsigned long)model->version(), TFLITE_SCHEMA_VERSION);
        return;
    }

    /* 2. Set up op resolver with DS-CNN operations */
    static tflite::MicroMutableOpResolver<12> resolver;
    resolver.AddConv2D();
    resolver.AddDepthwiseConv2D();
    resolver.AddFullyConnected();
    resolver.AddReshape();
    resolver.AddSoftmax();
    resolver.AddMean();          /* GlobalAveragePool lowered to Mean */
    resolver.AddAveragePool2D(); /* MobileNetV1 may use explicit AvgPool */
    resolver.AddPad();
    resolver.AddQuantize();
    resolver.AddDequantize();
    resolver.AddAdd();           /* MobileNetV2 residuals / padding ops */

    /* 3. Build interpreter */
    static tflite::MicroInterpreter interpreter(
        model, resolver, tensor_arena, kTensorArenaSize);

    TfLiteStatus status = interpreter.AllocateTensors();
    if (status != kTfLiteOk) {
        ESP_LOGE(TAG, "AllocateTensors() failed: arena too small");
        printf("\nBENCH_RESULT:"
               "framework=tflm,"
               "kernel=default,"
               "dtype=%s,"
               "model=%s,"
               "status=ARENA_TOO_SMALL,"
               "arena_kb=%d,"
               "model_flash_kb=%u\n",
               dtype_name, model_name,
               kTensorArenaSize / 1024,
               model_data_len / 1024);
        printf("BENCH_DONE\n");
        return;
    }

    TfLiteTensor *input = interpreter.input(0);
    TfLiteTensor *output = interpreter.output(0);

    printf("Model:       %s\n", model_name);
    printf("Type:        %s\n", dtype_name);
    printf("Arena size:  %d KB\n", kTensorArenaSize / 1024);
    printf("Model size:  %u bytes\n", model_data_len);
    printf("Input:       %d bytes\n", (int)input->bytes);
    printf("Output:      %d bytes\n", (int)output->bytes);

    /* 4. Warmup */
    printf("\nWarmup (%d runs)...\n", WARMUP_RUNS);
    for (int i = 0; i < WARMUP_RUNS; i++) {
        /* Fill input with deterministic data */
#if defined(BENCH_INT8) || defined(BENCH_WIDE)
        int8_t *in_data = input->data.int8;
        for (size_t j = 0; j < input->bytes; j++)
            in_data[j] = 1;
#else
        float *in_data = input->data.f;
        for (size_t j = 0; j < input->bytes / sizeof(float); j++)
            in_data[j] = 1.0f;
#endif

        int64_t t0 = esp_timer_get_time();
        status = interpreter.Invoke();
        int64_t t1 = esp_timer_get_time();

        if (status != kTfLiteOk) {
            ESP_LOGE(TAG, "Invoke() failed on warmup[%d]", i);
            return;
        }
        printf("  warmup[%d]: %.2f ms\n", i, (float)(t1 - t0) / 1000.0f);
    }

    /* 5. Timed runs */
    printf("\nBenchmark (%d runs)...\n", BENCH_RUNS);
    float latencies[BENCH_RUNS];

    for (int i = 0; i < BENCH_RUNS; i++) {
#if defined(BENCH_INT8) || defined(BENCH_WIDE)
        int8_t *in_data = input->data.int8;
        for (size_t j = 0; j < input->bytes; j++)
            in_data[j] = 1;
#else
        float *in_data = input->data.f;
        for (size_t j = 0; j < input->bytes / sizeof(float); j++)
            in_data[j] = 1.0f;
#endif

        int64_t t0 = esp_timer_get_time();
        status = interpreter.Invoke();
        int64_t t1 = esp_timer_get_time();

        if (status != kTfLiteOk) {
            ESP_LOGE(TAG, "Invoke() failed on run[%d]", i);
            return;
        }
        latencies[i] = (float)(t1 - t0) / 1000.0f;
        printf("  run[%d]: %.2f ms\n", i, latencies[i]);
    }

    /* 6. Statistics */
    float sum = 0, min_lat = latencies[0], max_lat = latencies[0];
    for (int i = 0; i < BENCH_RUNS; i++) {
        sum += latencies[i];
        if (latencies[i] < min_lat) min_lat = latencies[i];
        if (latencies[i] > max_lat) max_lat = latencies[i];
    }
    float mean = sum / BENCH_RUNS;

    float var_sum = 0;
    for (int i = 0; i < BENCH_RUNS; i++) {
        float diff = latencies[i] - mean;
        var_sum += diff * diff;
    }
    float stdev = sqrtf(var_sum / BENCH_RUNS);

    /* 7. Print output values (for accuracy validation) */
    printf("\nOutput values:\n");
#if defined(BENCH_INT8) || defined(BENCH_WIDE)
    int8_t *out = output->data.int8;
    printf("  OUTPUT_I8:");
    for (size_t j = 0; j < output->bytes; j++)
        printf(" %d", (int)out[j]);
    printf("\n");
#else
    float *out = output->data.f;
    printf("  OUTPUT_F32:");
    for (size_t j = 0; j < output->bytes / sizeof(float); j++)
        printf(" %.6f", out[j]);
    printf("\n");
#endif

    /* 8. Machine-parseable result line */
    printf("\nBENCH_RESULT:"
           "framework=tflm,"
           "kernel=default,"
           "dtype=%s,"
           "model=%s,"
           "latency_mean_ms=%.2f,"
           "latency_min_ms=%.2f,"
           "latency_max_ms=%.2f,"
           "latency_stdev_ms=%.2f,"
           "arena_kb=%d,"
           "model_flash_kb=%u,"
           "runs=%d\n",
           dtype_name,
           model_name,
           mean, min_lat, max_lat, stdev,
           kTensorArenaSize / 1024,
           model_data_len / 1024,
           BENCH_RUNS);

    printf("BENCH_DONE\n");
}

} /* extern "C" */
